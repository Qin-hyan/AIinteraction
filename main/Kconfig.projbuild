## main/Kconfig.projbuild
```kconfig
menu "Week 01 Sensor Web Configuration"

    config ESP_WIFI_SSID
        string "WiFi SSID"
        default "YOUR_WIFI_SSID"
        help
            WiFi SSID (network name) to connect to.
            Set your real SSID via idf.py menuconfig or local sdkconfig.
            Keep this repository free of real credentials.

    config ESP_WIFI_PASSWORD
        string "WiFi Password"
        default "YOUR_WIFI_PASSWORD"
        help
            WiFi password (minimum 8 characters for WPA2).
            Set your real password via idf.py menuconfig or local sdkconfig.
            Keep this repository free of real credentials.

endmenu

menu "Week 05 Voice Control Configuration"

    config VOICE_PC_URL
        string "PC voice control base URL"
        default ""
        help
            Base URL of the PC-side voice recording HTTP service
            (Week 05 Step 2A, service/voice_control_server.py), for example
            http://192.168.x.x:8080 -- do NOT put your real computer's
            private IP address or any credential in this repository.

            The firmware appends "/api/voice/start" and "/api/voice/stop"
            to this base URL, so do not include a path here.

            Leave empty (default) to keep voice control disabled: no task and
            no queue are created, an explicit warning is printed at boot, and
            the PLAY button keeps its Week 03 teaching-event behavior.

    config VOICE_HTTP_TIMEOUT_MS
        int "Voice control HTTP timeout (ms)"
        default 5000
        range 1000 30000
        help
            Timeout for one HTTP POST to the PC voice control service.
            Default: 5000 (5 seconds). The request runs in an independent
            FreeRTOS task, so this timeout only bounds how long that task may
            block; button scanning and the main loop stay responsive.

    config VOICE_BROWSER_URL
        string "Browser voice panel base URL"
        default "http://127.0.0.1:8080"
        help
            Base URL used by the Dashboard's browser-side voice panel.
            The browser runs on the same computer as the voice service, so
            loopback is the stable default and does not break when the PC's
            DHCP/LAN IP changes. The ESP32 PLAY button still uses
            VOICE_PC_URL (device -> PC over the LAN).

            Leave empty to hide/disable the browser voice panel.

endmenu

menu "Week 03 Help Uplink Configuration"

    config HELP_VPS_URL
        string "VPS endpoint URL for help event uplink"
        default ""
        help
            Full URL of the VPS endpoint that accepts help event POST requests.
            Example: http://192.168.1.100:8080/api/help/event
            Leave empty to disable uplink (help_uplink_send_event() will return
            ESP_ERR_INVALID_STATE without sending).

    config HELP_UPLINK_TIMEOUT_MS
        int "HTTP POST timeout (ms)"
        default 10000
        range 1000 60000
        help
            Timeout for the HTTP POST request to VPS in milliseconds.
            Default: 10000 (10 seconds).

endmenu

menu "Week 08 Vision Feedback Configuration"

    config VISION_API_URL
        string "Local vision API base URL"
        default "http://127.0.0.1:8090"
        help
            Base URL of the local vision feedback API service
            (service/vision_feedback_server.py, default 127.0.0.1:8090).
            The ESP32 Dashboard's embedded vision panel calls this local API
            from the browser (which runs on the same computer), so the
            loopback address 127.0.0.1 is the correct default and does not
            leak any device or computer LAN IP.

            Do NOT put a device IP or a computer's DHCP/LAN IP here. Leave
            empty to hide/disable the vision panel.

endmenu

menu "Week 08 PC Service Launcher Configuration"

    config PC_LAUNCHER_URL
        string "Local PC service launcher base URL"
        default "http://127.0.0.1:8079"
        help
            Base URL of the PC-side service launcher
            (service/service_launcher.py, default 127.0.0.1:8079).
            When the Dashboard page is opened, it calls this loopback URL to
            idempotently start the voice (8080) and vision (8090) services.

            Keep the loopback address: the launcher can start local processes,
            so it must never be reachable from the LAN. Browsers cannot start
            local processes by themselves; this launcher is the explicit local
            helper for that job. Leave empty to disable the automatic ensure
            call (the panel then shows "未配置" and services must be started
            manually).

endmenu
```
